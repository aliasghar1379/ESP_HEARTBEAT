#include <ESP8266WiFi.h>
#include <ESP8266WebServer.h>
#include <ESP8266HTTPClient.h>
#include <WiFiClient.h>
#include <Adafruit_GFX.h>     // Core graphics library
#include <Adafruit_ST7735.h>  // Hardware-specific library
#include <SPI.h>
#include <Wire.h>
#include "MAX30105.h"
#include "heartRate.h"

MAX30105 particleSensor;

#define BUTTON 10

// For the breakout, you can use any 2 or 3 pins
// These pins will also work for the 1.8" TFT shield
#define TFT_CS 15
#define TFT_RST 16  // you can also connect this to the Arduino reset \
                    // in which case, set this #define pin to -1!
#define TFT_DC 0

// Option 1 (recommended): must use the hardware SPI pins
// (for UNO thats sclk = 13 and sid = 11) and pin 10 must be
// an output. This is much faster - also required if you want
// to use the microSD card (see the image drawing example)
Adafruit_ST7735 tft = Adafruit_ST7735(TFT_CS, TFT_DC, TFT_RST);


// Option 2: use any pins but a little slower!
#define TFT_SCLK 14  // set these to be whatever pins you like!
#define TFT_MOSI 13  // set these to be whatever pins you like!
// Adafruit_ST7735 tft = Adafruit_ST7735(TFT_CS, TFT_DC, TFT_MOSI, TFT_SCLK, TFT_RST);

const char* serverName = "http://aliasgharnorouzi.ir/post-data.php";

String apiKeyValue = "YOUR API PASSWORD";

String sensorName = "Heart_Beat";
String sensorLocation = "Rasht_Hospital";

const byte RATE_SIZE = 4;  //Increase this for more averaging. 4 is good.
byte rates[RATE_SIZE];     //Array of heart rates
byte rateSpot = 0;
long lastBeat = 0;  //Time at which the last beat occurred

float beatsPerMinute;
int beatAvg;

float p = 3.1415926;
bool heart_start = false;
bool wifi_showed = false;
bool send = false;
bool black = false;

bool state = false;
bool buttonPressed = false;
unsigned long lastDebounceTime = 0;
unsigned long debounceDelay = 150;

const char* ssid = "HELATH_DEVICE";
const char* password = "12345678";

const unsigned char wifi[] PROGMEM = {
  // 'download, 20x20px
  0xff, 0xff, 0xf0, 0xff, 0xff, 0xf0, 0xfe, 0x07, 0xf0, 0xf0, 0x00, 0xf0, 0xc1, 0xf8, 0x30, 0x8f,
  0xff, 0x10, 0x1c, 0x03, 0x80, 0x38, 0x01, 0xc0, 0xe1, 0xf8, 0x70, 0xc7, 0xfe, 0x30, 0xee, 0x07,
  0x70, 0xfc, 0x03, 0xf0, 0xf8, 0xf1, 0xf0, 0xf9, 0x99, 0xf0, 0xff, 0x0f, 0xf0, 0xff, 0x0f, 0xf0,
  0xff, 0x0f, 0xf0, 0xff, 0x9f, 0xf0, 0xff, 0xff, 0xf0, 0xff, 0xff, 0xf0
};
const unsigned char heart[] PROGMEM = {
  // 'heart, 50x50px
  0x00, 0x00, 0x00, 0x00, 0x00, 0x00, 0x00, 0x00, 0x00, 0x00, 0x00, 0x00, 0x00, 0x00, 0x00, 0x00,
  0x00, 0x00, 0x00, 0x00, 0x00, 0x00, 0x00, 0x00, 0x00, 0x00, 0x00, 0x00, 0x00, 0x00, 0x00, 0x00,
  0x00, 0x00, 0x00, 0x00, 0x7c, 0x00, 0x00, 0x0f, 0x80, 0x00, 0x01, 0xff, 0x80, 0x00, 0x7f, 0xf0,
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  0x00, 0x00, 0x00, 0x00, 0x00, 0x00, 0x00, 0x00, 0x00, 0x00, 0x00, 0x00, 0x00, 0x00
};

const unsigned char no_touch[] PROGMEM = {
  // 'heart, 160x80px
  0x00, 0x00, 0x00, 0x00, 0x00, 0x00, 0x00, 0x00, 0x00, 0x00, 0x00, 0x00, 0x00, 0x00, 0x00, 0x00,
  0x00, 0x00, 0x00, 0x00, 0x00, 0x00, 0x00, 0x00, 0x00, 0x00, 0x00, 0x00, 0x00, 0x00, 0x00, 0x00,
  0x00, 0x00, 0x00, 0x00, 0x00, 0x00, 0x00, 0x00, 0x00, 0x00, 0x00, 0x00, 0x00, 0x00, 0x00, 0x00,
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  0x00, 0x00, 0x00, 0x00, 0x00, 0x00, 0x00, 0x00, 0x00, 0x00, 0x00, 0x00, 0x00, 0x00, 0x00, 0x00
};


const unsigned char welcome[] PROGMEM = {
  // 'heart, 160x79px
  0x00, 0x00, 0x00, 0x00, 0x00, 0x00, 0x00, 0x00, 0x00, 0x00, 0x00, 0x00, 0x00, 0x00, 0x00, 0x00,
  0x00, 0x00, 0x00, 0x00, 0x00, 0x00, 0x00, 0x00, 0x00, 0x00, 0x00, 0x00, 0x00, 0x00, 0x00, 0x00,
  0x00, 0x00, 0x00, 0x00, 0x00, 0x00, 0x00, 0x00, 0x00, 0x00, 0x00, 0x00, 0x00, 0x00, 0x00, 0x00,
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  0x00, 0x00, 0x00, 0x00, 0x00, 0x00, 0x00, 0x00, 0x00, 0x00, 0x00, 0x00
};


ESP8266WebServer server(80);

void handleRoot() {
  String content = "<html>";
  content += "<head>";
  content += "<meta name=\"viewport\" content=\"width=device-width, initial-scale=1\">";
  content += "<style>";
  content += "body { font-family: Arial, Helvetica, sans-serif; }";
  content += ".container { max-width: 500px; margin: auto; padding: 10px; }";
  content += "select, input[type=text], input[type=password] { width: 100%; padding: 12px 20px; margin: 8px 0; display: inline-block; border: 1px solid #ccc; border-radius: 4px; box-sizing: border-box; }";
  content += "input[type=submit] { background-color: #4CAF50; color: white; padding: 14px 20px; margin: 8px 0; border: none; border-radius: 4px; cursor: pointer; }";
  content += "input[type=submit]:hover { background-color: #45a049; }";
  content += "</style>";
  content += "</head>";
  content += "<body>";
  content += "<div class=\"container\">";
  content += "<h1>Wi-Fi Scanner</h1>";
  content += "<form action=\"/\" method=\"POST\">";
  content += "<label for=\"ssid\">Select a Wi-Fi network:</label>";
  content += "<hr>";
  int n = WiFi.scanNetworks();
  for (int i = 0; i < n; ++i) {
    content += "<label><input type=\"radio\" name=\"ssid\" value=\"";
    content += WiFi.SSID(i);
    content += "\">";
    content += WiFi.SSID(i);
    content += "</label><br>";
  }
  content += "<hr>";
  content += "<label for=\"new_ssid\">Enter a new SSID:</label>";
  content += "<input type=\"text\" id=\"new_ssid\" name=\"new_ssid\">";
  content += "<label for=\"password\">Enter password:</label>";
  content += "<input type=\"password\" id=\"password\" name=\"password\">";
  content += "<input type=\"submit\" value=\"Connect\">";
  content += "</form>";
  content += "</div>";
  content += "</body>";
  content += "</html>";
  server.send(200, "text/html", content);
}

void handleForm() {
  String radio_ssid = server.arg("ssid");
  String new_ssid = server.arg("new_ssid");
  String ssid = "";
  String password = server.arg("password");
  if (new_ssid != "") {
    ssid = new_ssid;
  } else if (radio_ssid != "") {
    ssid = radio_ssid;
  } else {
    server.send(400, "text/plain", "Error: Please select a Wi-Fi network or enter a new SSID");
    return;
  }
  if (password != "") {
    Serial.print("Connecting to ");
    Serial.println(ssid);
    WiFi.begin(ssid.c_str(), password.c_str());
    int i = 0;
    while (WiFi.status() != WL_CONNECTED && i < 10) {
      Serial.println("connecting...");
      delay(1000);
      i++;
    }
    if (WiFi.status() != WL_CONNECTED) {
      Serial.println("Failed to connect to Wi-Fi network.");
      String content = "<html><body>";
      content += "<h1>Wi-Fi Scanner</h1>";
      content += "<p>Failed to connect to Wi-Fi network:</p>";
      content += "<p>" + ssid + "</p>";
      content += "<p>Please check your password and try again.</p>";
      content += "</body></html>";
      server.send(200, "text/html", content);
    } else {
      Serial.println("Connected!");
      Serial.print("IP address: ");
      Serial.println(WiFi.localIP());
      String content = "<html><body>";
      content += "<h1>Wi-Fi Scanner</h1>";
      content += "<p>ESP Module connected successfully to the Wi-Fi network:</p>";
      content += "<p>" + ssid + "</p>";
      content += "</body></html>";
      server.send(200, "text/html", content);
      tft.fillScreen(ST7735_BLACK);  // Corrected line
      tft.drawBitmap(20, 20, wifi, 20, 20, ST7735_WHITE);
      tft.setTextSize(1);
      tft.setTextColor(ST7735_WHITE);
      tft.setCursor(50, 20);
      tft.println("Connected to:");
      tft.setCursor(50, 40);
      tft.println(ssid);
      delay(2000);
      wifi_showed = true;
    }
  } else {
    server.send(400, "text/plain", "Error: Password is missing");
  }
}


void setup(void) {
  Serial.begin(115200);
  WiFi.softAP(ssid, password);
  Serial.println("");
  Serial.println("AP created");
  Serial.println("IP address: ");
  Serial.println(WiFi.softAPIP());

  server.on("/config", HTTP_GET, handleRoot);
  server.on("/", HTTP_POST, handleForm);
  server.begin();
  Serial.println("Web server started");

  pinMode(BUTTON, INPUT_PULLUP);

  if (!particleSensor.begin(Wire, I2C_SPEED_FAST))  //Use default I2C port, 400kHz speed
  {
    Serial.println("MAX30105 was not found. Please check wiring/power. ");
    while (1)
      ;
  }

  particleSensor.setup();                     //Configure sensor with default settings
  particleSensor.setPulseAmplitudeRed(0x0A);  //Turn Red LED to low to indicate sensor is running
  particleSensor.setPulseAmplitudeGreen(0);   //Turn off Green LED

  // Use this initializer (uncomment) if you're using a 0.96" 180x60 TFT
  tft.initR(INITR_MINI160x80);  // initialize a ST7735S chip, mini display
  Serial.println("Initialized");
  tft.setRotation(1);
  tft.setSPISpeed(10000000);
  tft.fillScreen(ST7735_BLACK);
  tft.drawBitmap(0, 0, welcome, 160, 80, ST7735_WHITE);
}

void loop() {
  ESP.wdtFeed();
  if (WiFi.status() != WL_CONNECTED) {
    server.handleClient();
  } else {
    int reading = digitalRead(BUTTON);
    if (reading == HIGH) {
      lastDebounceTime = millis();
    }
    if (heart_start == true) {
      long irValue = particleSensor.getIR();
      if (checkForBeat(irValue) == true) {
        send = false;
        long delta = millis() - lastBeat;
        lastBeat = millis();

        beatsPerMinute = 60 / (delta / 1000.0);

        if (beatsPerMinute < 255 && beatsPerMinute > 20) {
          rates[rateSpot++] = (byte)beatsPerMinute;  //Store this reading in the array
          rateSpot %= RATE_SIZE;                     //Wrap variable

          //Take average of readings
          beatAvg = 0;
          for (byte x = 0; x < RATE_SIZE; x++)
            beatAvg += rates[x];
          beatAvg /= RATE_SIZE;
          tft.fillScreen(ST7735_BLACK);  // Corrected line
          tft.drawBitmap(30, 15, heart, 50, 50, ST7735_WHITE);
          tft.setTextSize(3);
          tft.setTextColor(ST7735_WHITE);
          tft.setCursor(100, 50);
          tft.println(beatAvg);
        }
      }

      if (irValue < 50000) {
        tft.fillScreen(ST7735_BLACK);
        tft.drawBitmap(0, 0, no_touch, 160, 80, ST7735_WHITE);
        if (beatAvg < 110 && beatAvg > 70 && send == false) {
          send_data(beatAvg);
          send = true;
        }
      }
    }
    if (wifi_showed == true) {
      if (reading == LOW && (millis() - lastDebounceTime) > debounceDelay) {
        tft.setTextSize(1);
        tft.fillScreen(ST7735_BLACK);
        tft.setTextColor(ST7735_WHITE);
        tft.setCursor(50, 20);
        tft.println("Touched");
        heart_start = true;
        delay(100);
      }
    }
  }
}
void send_data(int data) {
  HTTPClient http;
  WiFiClient client;
  http.begin(client, serverName);

  http.addHeader("Content-Type", "application/x-www-form-urlencoded");

  String httpRequestData = "api_key=" + apiKeyValue + "&SensorData=" + sensorName + "&LocationData=" + sensorLocation + "&value1=" + String(data);
  Serial.println("httpRequestData:");
  Serial.println(httpRequestData);
  if (send == false) {
    int httpResponseCode = http.POST(httpRequestData);
    if (httpResponseCode > 0) {
      Serial.println("HTTP Response Code:");
      Serial.println(httpResponseCode);
    } else {
      Serial.println("Error Code:");
      Serial.println(httpResponseCode);
    }
  }
  http.end();
  send = true;
  delay(100);
}
